## Kconfig
```kconfig
# Copyright (c) 2026 The ZMK Contributors
# SPDX-License-Identifier: MIT

config LINEA40_BATTERY_TEXT
    bool "Type both LiNEA40 battery levels"
    default y
    depends on SHIELD_LiNEA40_RIGHT
    depends on ZMK_BATTERY_REPORTING
    depends on ZMK_SPLIT_ROLE_CENTRAL
    depends on ZMK_SPLIT_BLE_CENTRAL_BATTERY_LEVEL_FETCHING

config LINEA40_INERTIAL_SCROLL
    bool "LiNEA40 inertial scroll input processor"
    default y
    depends on SHIELD_LiNEA40_RIGHT
    depends on ZMK_POINTING
    depends on ZMK_SPLIT_ROLE_CENTRAL
    depends on INPUT

config LINEA40_INERTIAL_SCROLL_DEBUG
    bool "Log LiNEA40 inertial scroll input windows"
    default n
    depends on LINEA40_INERTIAL_SCROLL

config LINEA40_AXIS_KEYS
    bool "LiNEA40 axis-to-key input processor"
    default y
    depends on SHIELD_LiNEA40_RIGHT
    depends on ZMK_POINTING
    depends on ZMK_SPLIT_ROLE_CENTRAL
    depends on INPUT

config LINEA40_AXIS_KEYS_THREAD_STACK_SIZE
    int "LiNEA40 axis-to-key worker thread stack size"
    default 1536
    depends on LINEA40_AXIS_KEYS

config LINEA40_AXIS_KEYS_THREAD_PRIORITY
    int "LiNEA40 axis-to-key worker thread priority"
    default 8
    depends on LINEA40_AXIS_KEYS
```

## config/west.yml
```yaml
manifest:
  remotes:
    - name: zmkfirmware
      url-base: https://github.com/zmkfirmware
    - name: badjeff
      url-base: https://github.com/badjeff
    - name: keyfreaks
      url-base: https://github.com/kay-yokoyama
    - name: caksoylar
      url-base: https://github.com/caksoylar
    - name: kot149
      url-base: https://github.com/kot149
    - name: mjmjm0101
      url-base: https://github.com/mjmjm0101
  projects:
    - name: zmk
      remote: zmkfirmware
      revision: v0.3
      import: app/west.yml
    - name: zmk-pmw3610-driver
      remote: badjeff
      revision: zmk-0.3
    - name: zmk-rgbled-widget
      remote: caksoylar
      revision: v0.3-branch
    - name: zmk-mouse-gesture
      remote: kot149
      revision: v1
    - name: zmk-input-processor-scroll-inertia
      remote: mjmjm0101
      revision: f7dadefee453d555fe066d13a3de3bb60739b45e
  self:
    path: config
```
